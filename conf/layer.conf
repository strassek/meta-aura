## conf/layer.conf
```bitbake
# We have a conf and classes directory, add to BBPATH
BBPATH := "${BBPATH}:${LAYERDIR}"

# We have a packages directory, add to BBFILES
BBFILES := "${BBFILES} ${LAYERDIR}/recipes-*/*/*.bb"

BBFILE_COLLECTIONS += "aura"
BBFILE_PATTERN_aura := "^${LAYERDIR}/"
BBFILE_PRIORITY_aura = "1"

PREFERRED_VERSION_libav = "9.16"
```
